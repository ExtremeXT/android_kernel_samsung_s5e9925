## drivers/gpu/drm/samsung/panel/s6e3fc3/Kconfig
```kconfig
menuconfig USDM_PANEL_S6E3FC3
	tristate "S6E3FC3 DDI Panel Driver"
	depends on USDM_PANEL
	depends on USDM_PANEL_OLED_COMMON
	default n
	help
		This enables S6E3FC3 DDI dependent panel drivers of
		common panel driver. say Y, if you have a panel based on
		the S6E3FC3 DDI.


########## FOR KUNIT ##########

config S6E3FC3_TEST
	bool "KUnit test for s6e3fc3 ddi driver"
	depends on SEC_KUNIT
	help
	  TODO: Describe config fully.



########## FOR KUNIT ##########

config S6E3FC3_R11S_TEST
	bool "KUnit test for tft_common ddi driver"
	depends on SEC_KUNIT
	help
	  TODO: Describe config fully.
```

## drivers/gpu/drm/samsung/panel/s6e3fc5/Kconfig
```kconfig
menuconfig USDM_PANEL_S6E3FC5
	tristate "S6E3FC5 DDI Panel Driver"
	depends on USDM_PANEL
	depends on USDM_PANEL_OLED_COMMON
	default n
	help
		This enables S6E3FC5 DDI dependent panel drivers of
		common panel driver. say Y, if you have a panel based on
		the S6E3FC5 DDI.


########## FOR KUNIT ##########

config S6E3FC5_TEST
	bool "KUnit test for s6e3fc5 ddi driver"
	depends on SEC_KUNIT
	help
	  TODO: Describe config fully.



########## FOR KUNIT ##########

config S6E3FC5_R11S_TEST
	bool "KUnit test for tft_common ddi driver"
	depends on SEC_KUNIT
	help
	  TODO: Describe config fully.
```
