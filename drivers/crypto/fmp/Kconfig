## drivers/crypto/fmp/Kconfig
```kconfig
#
# FMP controller drivers
#
config EXYNOS_FMP
	tristate "Samsung EXYNOS FMP driver"
	help
	  Say yes here to build support for FMP (Flash Memory Protector)
	  If unsure, say N.

	  To compile this driver as a module, choose M here
```

## drivers/net/wireless/broadcom/bcmdhd_101_24/Kconfig
```kconfig
#
# Copyright (C) 2022, Broadcom.
#
#      Unless you and Broadcom execute a separate written software license
# agreement governing use of this software, this software is licensed to you
# under the terms of the GNU General Public License version 2 (the "GPL"),
# available at http://www.broadcom.com/licenses/GPLv2.php, with the
# following added to such license:
#
#      As a special exception, the copyright holders of this software give you
# permission to link this software with independent modules, and to copy and
# distribute the resulting executable under terms of your choice, provided that
# you also meet, for each linked independent module, the terms and conditions of
# the license of that module.  An independent module is a module which is not
# derived from this software.  The special exception does not apply to any
# modifications of the software.
#
#
# <<Broadcom-WL-IPTag/Open:>>
#
config BROADCOM_WIFI
	bool "Broadcom WiFi Driver"
	depends on WLAN && BCM_DHD_WLAN
	default y
	help
	  This is a configuration for Broadcom WLAN driver.

config BCM4389
	tristate "Broadcom 4389 wireless cards support"
	depends on BROADCOM_WIFI
	help
	  This module adds support for wireless adapters based on
	  Broadcom 4389 chipset.

config BCMDHD_FW_PATH
	depends on BROADCOM_WIFI
	string "Firmware path"
	default "/etc/wifi/bcmdhd_sta.bin"
	help
	  Path to the firmware file.

config BCMDHD_NVRAM_PATH
	depends on BROADCOM_WIFI
	string "NVRAM path"
	default "/etc/wifi/nvram_net.txt"
	help
	  Path to the nvram file.

config BROADCOM_WIFI_RESERVED_MEM
	bool "BROADCOM Reserved memory for wifi device"
	depends on BROADCOM_WIFI
	default y
	help
	  This is a configuration for Broadcom WLAN driver.

config WIFI_BROADCOM_COB
        bool "BROADCOM WIFI COB"
        depends on BCM4389
        help
          This is a configuration for Broadcom WIFI COB Type.

config BCM4335BT
	bool "BROADCOM BTLOCK Enable"
	depends on BCM4335
	default y
	help
	  This is a configuration for bt lock enable.

config WLAN_REGION_CODE
	int "---Region codes for Broadcom WiFi Driver"
	depends on BROADCOM_WIFI
	default 100
	help
		This is a region code for Broadcom Wi-Fi featured functions.
		- 100 : EUR OPEN
		- 101 : EUR ORG
		- 200 : KOR OPEN
		- 201 : KOR SKT
		- 202 : KOR KTT
		- 203 : KOR LGT
		- 300 : CHN OPEN

config WLAIBSS
	bool "Advanced IBSS mode"
	depends on BCM4389
	default y
	help
	  This is a configuration for Oxygen Network.

config WL_RELMCAST
	bool "Reliable Multicast Support"
	depends on BCM4389
	default y
	help
	  This is a configuration for RMC.

config WL_NAN
	bool "NAN Feature"
	depends on BROADCOM_WIFI
	default n
	help
	  This is a configuration for NAN Feature.

config BCMDHD_PCIE
	bool "Enable PCIe I/F Support"
	depends on BCM4389 && PCI
	default y
	help
	  Enable PCI Express I/F Support

config BCMDHD_PREALLOC_PKTIDMAP
	bool "BROADCOM PCIE specific memory reserved for PKTIDMAP"
	depends on BROADCOM_WIFI_RESERVED_MEM && BCMDHD_PCIE
	help
	  Preallocated memory support for PCIE interface in Broadcom
	  WLAN driver.

config BCMDHD_PREALLOC_MEMDUMP
	bool "BROADCOM PCIE specific memory reserved for MEMDUMP"
	depends on BROADCOM_WIFI_RESERVED_MEM
	default y
	help
	  Preallocated memory support for dongle memory dump

config BCMDHD_OOB_HOST_WAKE
	bool "Use the external WLAN_HOST_WAKE pin"
	depends on BROADCOM_WIFI
	default y
	help
	  Use the external GPIO pin to wake up host

config SPLIT_ARGOS_SET
	bool "Support argos table"
	depends on BROADCOM_WIFI
	help
	To support SPLIT_ARGOS_SET

config WLAN_TSQ_MULTIPLIER
	bool "Enable TCP TSQ_MULTIPLIER"
	depends on BROADCOM_WIFI
	default n
	help
	This is configuration for TCP TSQ_MULTIPLIER

config WLAN_VENDOR_DUMP_ENABLE
	bool "Enable dump policy as Android Global DE Policy"
	depends on BROADCOM_WIFI
	default n
	help
	Change WLAN Debug dump policy as Global DE policy

config BCMDHD_GET_OOB_STATE
	bool "Support WLAN_HOST_WAKE pin level information"
	depends on BCMDHD_OOB_HOST_WAKE
	default y
	help
	Support WLAN_HOST_WAKE pin level information

config WLAN_ANQP_RMAC_BACKPORTED
	bool "Support backported kernel ANQP Random MAC Feature"
	depends on BROADCOM_WIFI
	default n
	help
	Support backported kernel ANQP Random MAC Feature
```

## sound/soc/samsung/slif/Kconfig
```kconfig
config SND_SOC_SAMSUNG_SLIF
	tristate "Samsung Serial LIF"
	help
	  Say Y if you want to use Serial LIF.

config SND_SOC_SAMSUNG_SLIF_VERSION
	hex "VTS Serial LIF IP version"
	depends on SND_SOC_SAMSUNG_SLIF
	default 0x10102
	help
	  Version of Serial LIF IP.
	  Value = 0x10000 * major + 0x100 * minor + rev.
	  Ex. 1.00 rev0 => 0x10000, 1.01 rev1 => 0x10101
```
